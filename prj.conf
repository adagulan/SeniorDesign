## prj.conf
```kconfig
# HealthyPi Move specific configurations
CONFIG_HPI_TODAY_SCREEN=n
CONFIG_HPI_GSR_SCREEN=y
CONFIG_HPI_GSR_STRESS_INDEX=y

CONFIG_BT=y
CONFIG_BT_PERIPHERAL=y
CONFIG_BT_BAS=y
CONFIG_BT_HRS=y
CONFIG_BT_DEVICE_NAME="healthypi move"
CONFIG_BT_DEVICE_APPEARANCE=833

CONFIG_BT_RX_STACK_SIZE=4096

CONFIG_BT_DIS=y
CONFIG_BT_DIS_PNP=n
CONFIG_BT_DIS_FW_REV=y
CONFIG_BT_DIS_MANUF="Protocentral"
CONFIG_BT_DIS_MODEL="Move"
#CONFIG_BT_DIS_SETTINGS=y
#CONFIG_BT_DIS_STR_MAX=100

# Reduced Bluetooth data packets for flash optimization
CONFIG_BT_L2CAP_TX_MTU=247
CONFIG_BT_BUF_ACL_RX_SIZE=251
CONFIG_BT_BUF_ACL_TX_SIZE=251
CONFIG_BT_CTLR_DATA_LENGTH_MAX=251

# Memory Configuration - Restored for debugging
CONFIG_HEAP_MEM_POOL_SIZE=8192        
CONFIG_SYSTEM_WORKQUEUE_STACK_SIZE=4096
CONFIG_MAIN_STACK_SIZE=4096           

# CONFIG_PM_OVERRIDE_EXTERNAL_DRIVER_CHECK=y

# Zephyr OS Configuration - Debug enabled
CONFIG_SMF=y
CONFIG_EVENTS=y
CONFIG_CBPRINTF_FP_SUPPORT=y

# Enable debugging features for development
CONFIG_ASSERT=y
CONFIG_DEBUG_INFO=n
CONFIG_DEBUG_THREAD_INFO=n
CONFIG_THREAD_NAME=n
CONFIG_THREAD_STACK_INFO=n

# Size optimization disabled for debugging
#CONFIG_SIZE_OPTIMIZATIONS=y
#CONFIG_COMPILER_OPT="-Os"

# Peripheral device drivers
CONFIG_SENSOR=y
CONFIG_SENSOR_INFO=y
CONFIG_SENSOR_MAX30001=y
CONFIG_SENSOR_MAX32664D=y
CONFIG_SENSOR_MAX30208=y
#CONFIG_SENSOR_MAXM86146=y
CONFIG_SENSOR_MAX32664C=y
CONFIG_SENSOR_ASYNC_API=y

CONFIG_REGULATOR=y
CONFIG_ADC=n

CONFIG_SENSOR_BMI323_HPI=y
CONFIG_RTC=y
CONFIG_RTC_RV8263=y

CONFIG_INPUT=y
CONFIG_INPUT_CHSC5816=y

CONFIG_I2C=y
CONFIG_I2C_NRFX=y
CONFIG_FUEL_GAUGE=y
CONFIG_NRF_FUEL_GAUGE=y
CONFIG_NRF_FUEL_GAUGE_VARIANT_SECONDARY_CELL=y

CONFIG_DISPLAY=y
CONFIG_SH8601=y

CONFIG_INPUT_GPIO_KEYS=y

CONFIG_LED=n
CONFIG_REBOOT=y
CONFIG_PWM=n

# Filesystem & Internal Flash support to store data
CONFIG_FLASH=y
CONFIG_FLASH_MAP=y
CONFIG_FLASH_PAGE_LAYOUT=y
CONFIG_FILE_SYSTEM=y
CONFIG_FILE_SYSTEM_LITTLEFS=y
CONFIG_MPU_ALLOW_FLASH_WRITE=y

# Enabled settings module and FS to store settings
CONFIG_SETTINGS=y
CONFIG_SETTINGS_RUNTIME=y
CONFIG_SETTINGS_FILE=y
CONFIG_SETTINGS_FILE_PATH="/lfs/sys/settings"

CONFIG_NVS=y

# LVGL Library Options - Debug configuration
CONFIG_LVGL=y
CONFIG_LV_COLOR_DEPTH_16=y
CONFIG_LV_COLOR_16_SWAP=y
CONFIG_LV_THEME_DEFAULT_DARK=y
CONFIG_LV_Z_MEM_POOL_SYS_HEAP=y
# Restored LVGL Memory Configuration for debugging
CONFIG_LV_Z_MEM_POOL_SIZE=24576         
#CONFIG_LV_MEM_CUSTOM=y
CONFIG_LV_Z_POINTER_INPUT_MSGQ_COUNT=50
CONFIG_LV_Z_POINTER_INPUT=y
#CONFIG_LV_DISP_DEF_REFR_PERIOD=30

# LVGL Font Options - Reduced font set to save flash
#CONFIG_LV_FONT_MONTSERRAT_12=y
#CONFIG_LV_FONT_MONTSERRAT_14=y
#CONFIG_LV_FONT_MONTSERRAT_16=y
CONFIG_LV_FONT_MONTSERRAT_20=y
CONFIG_LV_FONT_MONTSERRAT_24=y
#CONFIG_LV_FONT_MONTSERRAT_28=y
#CONFIG_LV_FONT_MONTSERRAT_34=y
#CONFIG_LV_FONT_MONTSERRAT_42=y
#CONFIG_LV_FONT_MONTSERRAT_48=y
#CONFIG_LV_FONT_MONTSERRAT_12_SUBPX=y
CONFIG_LV_FONT_DEFAULT_MONTSERRAT_24=y
#CONFIG_LV_USE_FONT_SUBPX=y

CONFIG_LV_USE_LABEL=y
CONFIG_LV_USE_MSGBOX=y
CONFIG_LV_USE_CHART=y
CONFIG_LV_USE_ROLLER=y
CONFIG_LV_USE_BUTTONMATRIX=y
CONFIG_LV_USE_SPINNER=y

CONFIG_LV_USE_CALENDAR=n
CONFIG_LV_USE_CHECKBOX=n
CONFIG_LV_USE_DROPDOWN=n
CONFIG_LV_USE_IMAGEBUTTON=n
CONFIG_LV_USE_KEYBOARD=n
CONFIG_LV_USE_LIST=n
CONFIG_LV_USE_MENU=n
CONFIG_LV_USE_LOTTIE=n
CONFIG_LV_USE_CANVAS=n
CONFIG_LV_USE_ANIMIMG=n
CONFIG_LV_USE_LED=n
CONFIG_LV_USE_LINE=n
CONFIG_LV_USE_SCALE=n
CONFIG_LV_USE_SPINBOX=n
CONFIG_LV_USE_TABLE=n
CONFIG_LV_USE_TABVIEW=n
CONFIG_LV_USE_TILEVIEW=n
CONFIG_LV_USE_WIN=n

# USB Configuration
CONFIG_USB_DEVICE_STACK=y
CONFIG_USB_DEVICE_PRODUCT="healthypi move"
CONFIG_USB_DEVICE_PID=0x0001
CONFIG_USB_DEVICE_VID=0x4440
CONFIG_USB_DEVICE_INITIALIZE_AT_BOOT=n

# Enable the serial MCUmgr transport.
CONFIG_BASE64=y
#CONFIG_MCUMGR_TRANSPORT_UART=y
CONFIG_NORDIC_QSPI_NOR=y
CONFIG_NORDIC_QSPI_NOR_FLASH_LAYOUT_PAGE_SIZE=4096
CONFIG_NORDIC_QSPI_NOR_STACK_WRITE_BUFFER_SIZE=16

CONFIG_PM_PARTITION_REGION_LITTLEFS_EXTERNAL=y
CONFIG_PM_PARTITION_SIZE_LITTLEFS=0x200000
CONFIG_PM_EXTERNAL_FLASH_MCUBOOT_SECONDARY=y

CONFIG_REQUIRES_FULL_LIBC=y
CONFIG_CMSIS_DSP=y
CONFIG_CMSIS_DSP_FILTERING=y

CONFIG_PM=y
CONFIG_PM_DEVICE=y
#CONFIG_PM_DEVICE_RUNTIME=y

# Enable the poweroff command (for power profiling)
CONFIG_POWEROFF=y

CONFIG_ZBUS=y

# Bootloader Configuration
CONFIG_BOOTLOADER_MCUBOOT=y
#CONFIG_SECURE_BOOT=y

# Enable MCUmgr and dependencies.

CONFIG_FLASH=y

CONFIG_MCUMGR=y
CONFIG_IMG_MANAGER=y
CONFIG_MCUMGR_GRP_IMG=y
CONFIG_MCUMGR_GRP_OS=y
CONFIG_MCUMGR_GRP_FS=y

CONFIG_NET_BUF=y
CONFIG_ZCBOR=y
CONFIG_CRC=y
CONFIG_MCUMGR=y
CONFIG_STREAM_FLASH=y
CONFIG_FLASH_MAP=y

CONFIG_MCUMGR_TRANSPORT_BT_REASSEMBLY=y
CONFIG_MCUMGR_TRANSPORT_NETBUF_SIZE=1024
CONFIG_MCUMGR_GRP_OS_MCUMGR_PARAMS=y
# Increased from 2048 to 4096 to prevent stack overflow during file downloads via SMP
# File system operations + CBOR encoding + network buffers require more stack space
CONFIG_MCUMGR_TRANSPORT_WORKQUEUE_STACK_SIZE=4096

CONFIG_MCUMGR_MGMT_NOTIFICATION_HOOKS=y
CONFIG_MCUMGR_GRP_IMG_UPLOAD_CHECK_HOOK=y
CONFIG_MCUMGR_GRP_IMG_STATUS_HOOKS=y

CONFIG_NCS_SAMPLE_MCUMGR_BT_OTA_DFU=y
CONFIG_NCS_SAMPLE_MCUMGR_BT_OTA_DFU_SPEEDUP=y


CONFIG_NCS_APPLICATION_BOOT_BANNER_STRING="HealthyPi Move"

# Debug logging options - Re-enabled for debugging
CONFIG_SERIAL=y
CONFIG_LOG=y
CONFIG_CONSOLE=y 
CONFIG_UART_CONSOLE=y

CONFIG_USE_SEGGER_RTT=n
CONFIG_SHELL_BACKEND_RTT=n 
CONFIG_LOG_BACKEND_RTT=n

# Enable individual sensor logging for debugging
CONFIG_SENSOR_LOG_LEVEL_INF=y
CONFIG_LV_USE_LOG=n
CONFIG_LV_LOG_LEVEL_WARN=y
CONFIG_DISPLAY_LOG_LEVEL_ERR=y
CONFIG_INPUT_LOG_LEVEL_ERR=y

#Setup individual log levels for each sensor - enabled for debugging
CONFIG_MAX32664C_LOG_LEVEL_INF=y
CONFIG_MAX32664D_LOG_LEVEL_INF=y
CONFIG_BMI323_HPI_LOG_LEVEL_INF=y
CONFIG_MAX30001_LOG_LEVEL_INF=y

CONFIG_MAX32664_UPDATER=y
CONFIG_MAX32664_UPDATER_LOG_LEVEL_ERR=y

# Init changes for QSPI XIP code placement
#CONFIG_CUSTOM_LINKER_SCRIPT="linker_arm_extxip.ld"
#CONFIG_FLASH_INIT_PRIORITY=40
#CONFIG_SHELL_BACKEND_SERIAL_INIT_PRIORITY=50
#CONFIG_CODE_DATA_RELOCATION=y
#CONFIG_NORDIC_QSPI_NOR_XIP=y

# Configure Bluetooth Security Manager
CONFIG_BT_SMP=y
CONFIG_BT_SIGNING=y
CONFIG_BT_BONDABLE=y

CONFIG_BT_KEYS_OVERWRITE_OLDEST=y
CONFIG_BT_MAX_PAIRED=2
CONFIG_BT_SETTINGS=y


# CONFIG_LOG=y
# CONFIG_LOG_MODE_DEFERRED=y
# CONFIG_CBPRINTF_FP_SUPPORT=y
# CONFIG_NEWLIB_LIBC=y
# CONFIG_NEWLIB_LIBC_FLOAT_PRINTF=y

# CONFIG_CBPRINTF_COMPLETE=y


# Enable full libc with float printf support
CONFIG_CBPRINTF_FP_SUPPORT=n
CONFIG_CBPRINTF_COMPLETE=n

# CONFIG_MINIMAL_LIBC=y
CONFIG_CMSIS_DSP=y
CONFIG_CMSIS_DSP_TRANSFORM=y
CONFIG_CMSIS_DSP_SUPPORT=y
CONFIG_CMSIS_DSP_FASTMATH=y
```

## src/ble_module.c
```c
/*
 * HealthyPi Move
 * 
 * SPDX-License-Identifier: MIT
 *
 * Copyright (c) 2025 Protocentral Electronics
 *
 * Author: Ashwin Whitchurch, Protocentral Electronics
 * Contact: ashwin@protocentral.com
 *
 * Permission is hereby granted, free of charge, to any person obtaining a copy
 * of this software and associated documentation files (the "Software"), to deal
 * in the Software without restriction, including without limitation the rights
 * to use, copy, modify, merge, publish, distribute, sublicense, and/or sell
 * copies of the Software, and to permit persons to whom the Software is
 * furnished to do so, subject to the following conditions:
 *
 * The above copyright notice and this permission notice shall be included in all
 * copies or substantial portions of the Software.
 *
 * THE SOFTWARE IS PROVIDED "AS IS", WITHOUT WARRANTY OF ANY KIND, EXPRESS OR
 * IMPLIED, INCLUDING BUT NOT LIMITED TO THE WARRANTIES OF MERCHANTABILITY,
 * FITNESS FOR A PARTICULAR PURPOSE AND NONINFRINGEMENT. IN NO EVENT SHALL THE
 * AUTHORS OR COPYRIGHT HOLDERS BE LIABLE FOR ANY CLAIM, DAMAGES OR OTHER
 * LIABILITY, WHETHER IN AN ACTION OF CONTRACT, TORT OR OTHERWISE, ARISING FROM,
 * OUT OF OR IN CONNECTION WITH THE SOFTWARE OR THE USE OR OTHER DEALINGS IN THE
 * SOFTWARE.
 */


#include <zephyr/kernel.h>
#include <zephyr/logging/log.h>

#include <zephyr/bluetooth/bluetooth.h>
#include <zephyr/bluetooth/hci.h>
#include <zephyr/bluetooth/conn.h>
#include <zephyr/bluetooth/uuid.h>
#include <zephyr/bluetooth/gatt.h>
#include <zephyr/bluetooth/services/bas.h>
#include <zephyr/bluetooth/services/hrs.h>
#include <zephyr/sys/ring_buffer.h>
#include <zephyr/zbus/zbus.h>

#include <zephyr/settings/settings.h>
#include <app_version.h>

#include "cmd_module.h"
#include "hpi_common_types.h"
#include "ble_module.h"
#include "ui/move_ui.h"

#define LOG_LEVEL CONFIG_LOG_DEFAULT_LEVEL
LOG_MODULE_REGISTER(ble_module, LOG_LEVEL_DBG);
static bool temp_notify_enabled = false;
struct bt_conn *current_conn;

// BLE GATT Identifiers

#define HPI_SPO2_SERVICE BT_UUID_DECLARE_16(BT_UUID_POS_VAL)
#define HPI_SPO2_CHAR BT_UUID_DECLARE_16(BT_UUID_GATT_PLX_SCM_VAL)

#define HPI_TEMP_SERVICE BT_UUID_DECLARE_16(BT_UUID_HTS_VAL)
#define HPI_TEMP_CHAR BT_UUID_DECLARE_16(BT_UUID_TEMPERATURE_VAL)

// ECG/GSR Service 00001122-0000-1000-8000-00805f9b34fb
#define UUID_HPI_ECG_GSR_SERV BT_UUID_DECLARE_128(BT_UUID_128_ENCODE(0x00001122, 0x0000, 0x1000, 0x8000, 0x00805f9b34fb))

// ECG Characteristic 00001424-0000-1000-8000-00805f9b34fb
#define UUID_HPI_ECG_CHAR BT_UUID_DECLARE_128(BT_UUID_128_ENCODE(0x00001424, 0x0000, 0x1000, 0x8000, 0x00805f9b34fb))

// GSR Characteristic babe4a4c-7789-11ed-a1eb-0242ac120002
#define UUID_HPI_GSR_CHAR BT_UUID_DECLARE_128(BT_UUID_128_ENCODE(0xbabe4a4c, 0x7789, 0x11ed, 0xa1eb, 0x0242ac120002))

// PPG Service cd5c7491-4448-7db8-ae4c-d1da8cba36d0
#define UUID_HPI_PPG_SERV BT_UUID_DECLARE_128(BT_UUID_128_ENCODE(0xcd5c7491, 0x4448, 0x7db8, 0xae4c, 0xd1da8cba36d0))

// PPG Wrist Characteristic cd5c1525-4448-7db8-ae4c-d1da8cba36d0
#define UUID_HPI_PPG_WR_CHAR BT_UUID_DECLARE_128(BT_UUID_128_ENCODE(0xcd5c1525, 0x4448, 0x7db8, 0xae4c, 0xd1da8cba36d0))

// PPG Finger Characteristic cd5ca86f-4448-7db8-ae4c-d1da8cba36d0
#define UUID_HPI_PPG_FI_CHAR BT_UUID_DECLARE_128(BT_UUID_128_ENCODE(0xcd5ca86f, 0x4448, 0x7db8, 0xae4c, 0xd1da8cba36d0))

#define CMD_SERVICE_UUID 0xdc, 0xad, 0x7f, 0xc4, 0x23, 0x90, 0x4d, 0xd4, \
						 0x96, 0x8d, 0x0f, 0x97, 0x92, 0x74, 0xbf, 0x01

#define CMD_TX_CHARACTERISTIC_UUID 0xdc, 0xad, 0x7f, 0xc4, 0x23, 0x90, 0x4d, 0xd4, \
								   0x96, 0x8d, 0x0f, 0x97, 0x28, 0x15, 0xbf, 0x01

#define CMD_RX_CHARACTERISTIC_UUID 0xdc, 0xad, 0x7f, 0xc4, 0x23, 0x90, 0x4d, 0xd4, \
								   0x96, 0x8d, 0x0f, 0x97, 0x27, 0x15, 0xbf, 0x01

#define UUID_HPI_CMD_SERVICE BT_UUID_DECLARE_128(CMD_SERVICE_UUID)
#define UUID_HPI_CMD_SERVICE_CHAR_TX BT_UUID_DECLARE_128(CMD_TX_CHARACTERISTIC_UUID)
#define UUID_HPI_CMD_SERVICE_CHAR_RX BT_UUID_DECLARE_128(CMD_RX_CHARACTERISTIC_UUID)

static const struct bt_data ad[] = {
	BT_DATA_BYTES(BT_DATA_FLAGS, (BT_LE_AD_GENERAL | BT_LE_AD_NO_BREDR)),
	BT_DATA_BYTES(BT_DATA_UUID16_ALL,
				  BT_UUID_16_ENCODE(BT_UUID_HRS_VAL),
				  BT_UUID_16_ENCODE(BT_UUID_BAS_VAL),
				  BT_UUID_16_ENCODE(BT_UUID_DIS_VAL))};

static const struct bt_data sd[] = {
	BT_DATA(BT_DATA_NAME_COMPLETE, CONFIG_BT_DEVICE_NAME, sizeof(CONFIG_BT_DEVICE_NAME) - 1),
};

extern struct k_msgq q_cmd_msg;
extern struct k_sem sem_ble_thread_start;

static void spo2_on_cccd_changed(const struct bt_gatt_attr *attr, uint16_t value)
{
}

static void temp_on_cccd_changed(const struct bt_gatt_attr *attr, uint16_t value)
{
	temp_notify_enabled = (value == BT_GATT_CCC_NOTIFY);
}

static void ppg_fi_on_cccd_changed(const struct bt_gatt_attr *attr, uint16_t value)
{
	ARG_UNUSED(attr);
	switch (value)
	{
	case BT_GATT_CCC_NOTIFY:
		LOG_DBG("PPG Finger CCCD subscribed");
		break;
	case BT_GATT_CCC_INDICATE:
		// Start sending stuff via indications
		break;
	case 0:
		LOG_DBG("PPG Finger CCCD unsubscribed");
		break;
	default:
		LOG_DBG("Error, CCCD has been set to an invalid value");
	}
}

static void ecg_on_cccd_changed(const struct bt_gatt_attr *attr, uint16_t value)
{
	ARG_UNUSED(attr);
	switch (value)
	{
	case BT_GATT_CCC_NOTIFY:
		LOG_DBG("ECG CCCD subscribed");
		break;
	case BT_GATT_CCC_INDICATE:
		// Start sending stuff via indications
		break;
	case 0:
		LOG_DBG("ECG CCCD unsubscribed");
		break;
	default:
		LOG_DBG("Error, CCCD has been set to an invalid value");
	}
}

static void gsr_on_cccd_changed(const struct bt_gatt_attr *attr, uint16_t value)
{
	ARG_UNUSED(attr);
	switch (value)
	{
	case BT_GATT_CCC_NOTIFY:
		
		break;
	case BT_GATT_CCC_INDICATE:
		// Start sending stuff via indications
		LOG_DBG("GSR CCCD subscribed");
		break;
	case 0:
		LOG_DBG("GSR CCCD unsubscribed");
		break;
	default:
		LOG_DBG("Error, CCCD has been set to an invalid value");
	}
}

static void ppg_wr_on_cccd_changed(const struct bt_gatt_attr *attr, uint16_t value)
{
	ARG_UNUSED(attr);
	switch (value)
	{
	case BT_GATT_CCC_NOTIFY:
		LOG_DBG("PPG Wrist CCCD subscribed");
		break;
	case BT_GATT_CCC_INDICATE:
		// Start sending stuff via indications
		break;
	case 0:
		LOG_DBG("PPG Wrist CCCD unsubscribed");
		break;
	default:
		LOG_DBG("Error, CCCD has been set to an invalid value");
	}
}

uint8_t in_data_buffer[50];

BT_GATT_SERVICE_DEFINE(hpi_spo2_service,
					   BT_GATT_PRIMARY_SERVICE(HPI_SPO2_SERVICE),
					   BT_GATT_CHARACTERISTIC(HPI_SPO2_CHAR,
											  BT_GATT_CHRC_READ | BT_GATT_CHRC_NOTIFY,
											  BT_GATT_PERM_READ_ENCRYPT,
											  NULL, NULL, NULL),
					   BT_GATT_CCC(spo2_on_cccd_changed,
								   BT_GATT_PERM_READ | BT_GATT_PERM_WRITE), );

BT_GATT_SERVICE_DEFINE(hpi_temp_service,
					   BT_GATT_PRIMARY_SERVICE(HPI_TEMP_SERVICE),
					   BT_GATT_CHARACTERISTIC(HPI_TEMP_CHAR,
											  BT_GATT_CHRC_READ | BT_GATT_CHRC_NOTIFY,
											  BT_GATT_PERM_READ_ENCRYPT,
											  NULL, NULL, NULL),
					   BT_GATT_CCC(temp_on_cccd_changed,
								   BT_GATT_PERM_READ | BT_GATT_PERM_WRITE), );

BT_GATT_SERVICE_DEFINE(hpi_ppg_service,
					   BT_GATT_PRIMARY_SERVICE(UUID_HPI_PPG_SERV),
					   BT_GATT_CHARACTERISTIC(UUID_HPI_PPG_WR_CHAR,
											  BT_GATT_CHRC_READ | BT_GATT_CHRC_NOTIFY,
											  BT_GATT_PERM_READ,
											  NULL, NULL, NULL),
					   BT_GATT_CCC(ppg_wr_on_cccd_changed,
								   BT_GATT_PERM_READ | BT_GATT_PERM_WRITE),
					   BT_GATT_CHARACTERISTIC(UUID_HPI_PPG_FI_CHAR,
											  BT_GATT_CHRC_READ | BT_GATT_CHRC_NOTIFY,
											  BT_GATT_PERM_READ,
											  NULL, NULL, NULL),
					   BT_GATT_CCC(ppg_fi_on_cccd_changed,
								   BT_GATT_PERM_READ | BT_GATT_PERM_WRITE), );

BT_GATT_SERVICE_DEFINE(hpi_ecg_gsr_service,
					   BT_GATT_PRIMARY_SERVICE(UUID_HPI_ECG_GSR_SERV),
					   BT_GATT_CHARACTERISTIC(UUID_HPI_ECG_CHAR,
											  BT_GATT_CHRC_READ | BT_GATT_CHRC_NOTIFY,
											  BT_GATT_PERM_READ,
											  NULL, NULL, NULL),
					   BT_GATT_CCC(ecg_on_cccd_changed,
								   BT_GATT_PERM_READ | BT_GATT_PERM_WRITE),
					   BT_GATT_CHARACTERISTIC(UUID_HPI_GSR_CHAR,
											  BT_GATT_CHRC_READ | BT_GATT_CHRC_NOTIFY,
											  BT_GATT_PERM_READ,
											  NULL, NULL, NULL),
					   BT_GATT_CCC(gsr_on_cccd_changed,
								   BT_GATT_PERM_READ | BT_GATT_PERM_WRITE), );
int ble_temp_notify(double temp_c)
{
	if (!temp_notify_enabled)
	{ return 0;
	}
	int16_t temp_ble = (int16_t)(temp_c * 100.0);

	return bt_gatt_notify(NULL,
						 &hpi_temp_service.attrs[2],
						 &temp_ble,
						 sizeof(temp_ble));
}
/* This function is called whenever the RX Characteristic has been written to by a Client */
static ssize_t on_receive_cmd(struct bt_conn *conn,
							  const struct bt_gatt_attr *attr,
							  const void *buf,
							  uint16_t len,
							  uint16_t offset,
							  uint8_t flags)
{
	const uint8_t *buffer = buf;

	// LOG_DBG("Received CMD len %d \n", len);

	/*for (uint8_t i = 0; i < len; i++)
	{
		in_data_buffer[i] = buffer[i];
		printk("%02X", buffer[i]);
	}
	printk("\n");
	*/

	struct hpi_cmd_data_obj_t cmd_data_obj;
	cmd_data_obj.pkt_type = 0x00;
	cmd_data_obj.data_len = len;
	memcpy(cmd_data_obj.data, buffer, len);

	k_msgq_put(&q_cmd_msg, &cmd_data_obj, K_MSEC(100));

	return len;
}

static void cmd_on_cccd_changed(const struct bt_gatt_attr *attr, uint16_t value)
{
	ARG_UNUSED(attr);
	switch (value)
	{
	case BT_GATT_CCC_NOTIFY:
		LOG_DBG("CMD RX/TX CCCD subscribed");
		break;

	case BT_GATT_CCC_INDICATE:
		// Start sending stuff via indications
		break;

	case 0:
		LOG_DBG("CMD RX/TX CCCD unsubscribed");
		break;

	default:
		LOG_DBG("Error, CCCD has been set to an invalid value");
	}
}

BT_GATT_SERVICE_DEFINE(hpi_cmd_service,
					   BT_GATT_PRIMARY_SERVICE(UUID_HPI_CMD_SERVICE),
					   BT_GATT_CHARACTERISTIC(UUID_HPI_CMD_SERVICE_CHAR_TX,
											  BT_GATT_CHRC_WRITE | BT_GATT_CHRC_WRITE_WITHOUT_RESP | BT_GATT_CHRC_READ,
											  BT_GATT_PERM_READ_AUTHEN | BT_GATT_PERM_WRITE_AUTHEN,
											  NULL, on_receive_cmd, NULL),
					   BT_GATT_CHARACTERISTIC(UUID_HPI_CMD_SERVICE_CHAR_RX,
											  BT_GATT_CHRC_NOTIFY | BT_GATT_CHRC_WRITE_WITHOUT_RESP | BT_GATT_CHRC_READ,
											  BT_GATT_PERM_READ_AUTHEN | BT_GATT_PERM_WRITE_AUTHEN,
											  NULL, NULL, NULL),
					   BT_GATT_CCC(cmd_on_cccd_changed,
								   BT_GATT_PERM_READ | BT_GATT_PERM_WRITE), );

void hpi_ble_send_data(const uint8_t *data, uint16_t len)
{

	const struct bt_gatt_attr *attr = &hpi_cmd_service.attrs[4];

	// printk("Sending data len %d \n", len);

	bt_gatt_notify(NULL, attr, data, len);
}

void ble_ppg_notify_wr(uint32_t *ppg_data, uint8_t len)
{
	uint8_t out_data[128];

	for (int i = 0; i < len; i++)
	{
		out_data[i * 4] = (uint8_t)ppg_data[i];
		out_data[i * 4 + 1] = (uint8_t)(ppg_data[i] >> 8);
		out_data[i * 4 + 2] = (uint8_t)(ppg_data[i] >> 16);
		out_data[i * 4 + 3] = (uint8_t)(ppg_data[i] >> 24);
	}

	// LOG_DBG("PPG Not len %d", len);

	bt_gatt_notify(NULL, &hpi_ppg_service.attrs[2], &out_data, len * 4);
}

void ble_ppg_notify_fi(uint32_t *ppg_data, uint8_t len)
{
	uint8_t out_data[128];

	for (int i = 0; i < len; i++)
	{
		out_data[i * 4] = (uint8_t)ppg_data[i];
		out_data[i * 4 + 1] = (uint8_t)(ppg_data[i] >> 8);
		out_data[i * 4 + 2] = (uint8_t)(ppg_data[i] >> 16);
		out_data[i * 4 + 3] = (uint8_t)(ppg_data[i] >> 24);
	}

	// LOG_DBG("PPG Not len %d", len);

	bt_gatt_notify(NULL, &hpi_ppg_service.attrs[4], &out_data, len * 4);
}

void ble_ecg_notify(int32_t *ecg_data, uint8_t len)
{ 
	uint8_t out_data[128];
	
	for (int i = 0; i < len; i++)
	{
		out_data[i * 4] = (uint8_t)ecg_data[i];
		out_data[i * 4 + 1] = (uint8_t)(ecg_data[i] >> 8);
		out_data[i * 4 + 2] = (uint8_t)(ecg_data[i] >> 16);
		out_data[i * 4 + 3] = (uint8_t)(ecg_data[i] >> 24);
	}

	// LOG_DBG("ECG Not len %d", len);

	bt_gatt_notify(NULL, &hpi_ecg_gsr_service.attrs[2], &out_data, len * 4);
}

void ble_gsr_notify(int32_t *gsr_data, uint8_t len)
{
	uint8_t out_data[128];
	
	for (int i = 0; i < len; i++)
    {
        out_data[i * 4]     = (uint8_t)gsr_data[i];
        out_data[i * 4 + 1] = (uint8_t)(gsr_data[i] >> 8);
        out_data[i * 4 + 2] = (uint8_t)(gsr_data[i] >> 16);
        out_data[i * 4 + 3] = (uint8_t)(gsr_data[i] >> 24);
    }

	//LOG_DBG("GSR Not len %d", len);

	bt_gatt_notify(NULL, &hpi_ecg_gsr_service.attrs[4], &out_data, len * 4);
	
}

void ble_bpt_cal_progress_notify(uint8_t bpt_status, uint8_t bpt_progress)
{
	uint8_t out_data[3];

	out_data[0] = bpt_status;
	out_data[1] = bpt_progress;
	out_data[2] = 0x00;

	bt_gatt_notify(NULL, &hpi_cmd_service.attrs[4], &out_data, sizeof(out_data));
}

void ble_hrs_notify(uint16_t hr_val)
{
	bt_hrs_notify(hr_val);
}

void ble_bas_notify(uint8_t batt_level)
{
	bt_bas_set_battery_level(batt_level);
}

static void connected(struct bt_conn *conn, uint8_t err)
{
	char addr[BT_ADDR_LE_STR_LEN];

	bt_addr_le_to_str(bt_conn_get_dst(conn), addr, sizeof(addr));

	if (err)
	{
		LOG_ERR("Failed to connect to %s, err 0x%02x %s\n", addr,
				err, bt_hci_err_to_str(err));
		return;
	}

	LOG_INF("Connected to %s\n", addr);

	if (bt_conn_set_security(conn, BT_SECURITY_L2))
	{
		LOG_ERR("Failed to set security\n");
	}
}

static void disconnected(struct bt_conn *conn, uint8_t reason)
{
	char addr[BT_ADDR_LE_STR_LEN];

	bt_addr_le_to_str(bt_conn_get_dst(conn), addr, sizeof(addr));

	LOG_INF("Disconnected from %s, reason 0x%02x %s\n", addr,
			reason, bt_hci_err_to_str(reason));
}

static void security_changed(struct bt_conn *conn, bt_security_t level,
							 enum bt_security_err err)
{
	char addr[BT_ADDR_LE_STR_LEN];

	bt_addr_le_to_str(bt_conn_get_dst(conn), addr, sizeof(addr));

	if (!err)
	{
		LOG_INF("Security changed: %s level %u\n", addr, level);
	}
	else
	{
		LOG_ERR("Security failed: %s level %u err %s(%d)\n", addr, level,
			   bt_security_err_to_str(err), err);
	}
}

BT_CONN_CB_DEFINE(conn_callbacks) = {
	.connected = connected,
	.disconnected = disconnected,
	.security_changed = security_changed,
};

static void auth_passkey_display(struct bt_conn *conn, unsigned int passkey)
{
	char addr[BT_ADDR_LE_STR_LEN];

	bt_addr_le_to_str(bt_conn_get_dst(conn), addr, sizeof(addr));

	LOG_INF("Passkey for %s: %06u\n", addr, passkey);
	hpi_load_scr_spl(SCR_SPL_BLE, SCROLL_NONE, HPI_BLE_EVENT_PAIR_REQUEST, passkey, 0, 0);
}

static void auth_cancel(struct bt_conn *conn)
{
	char addr[BT_ADDR_LE_STR_LEN];

	bt_addr_le_to_str(bt_conn_get_dst(conn), addr, sizeof(addr));

	LOG_INF("Pairing cancelled: %s\n", addr);
	hpi_load_scr_spl(SCR_SPL_BLE, SCROLL_NONE, HPI_BLE_EVENT_PAIR_CANCELLED, 0, 0, 0);
}

static void pairing_complete(struct bt_conn *conn, bool bonded)
{
	char addr[BT_ADDR_LE_STR_LEN];

	bt_addr_le_to_str(bt_conn_get_dst(conn), addr, sizeof(addr));

	LOG_INF("Pairing completed: %s, bonded: %d\n", addr, bonded);
	hpi_load_scr_spl(SCR_SPL_BLE, SCROLL_NONE, HPI_BLE_EVENT_PAIR_SUCCESS, bonded ? 1 : 0, 0, 0);
}

static void pairing_failed(struct bt_conn *conn, enum bt_security_err reason)
{
	char addr[BT_ADDR_LE_STR_LEN];

	bt_addr_le_to_str(bt_conn_get_dst(conn), addr, sizeof(addr));

	LOG_ERR("Pairing failed conn: %s, reason %d %s\n", addr, reason,
			bt_security_err_to_str(reason));
	hpi_load_scr_spl(SCR_SPL_BLE, SCROLL_NONE, HPI_BLE_EVENT_PAIR_FAILED, reason, 0, 0);
}

static struct bt_conn_auth_cb conn_auth_callbacks = {
	.passkey_display = auth_passkey_display,
	.cancel = auth_cancel,
};

static struct bt_conn_auth_info_cb conn_auth_info_callbacks = {
	.pairing_complete = pairing_complete,
	.pairing_failed = pairing_failed,
};

void ble_module_init()
{
	int err = 0;

	err = bt_enable(NULL);
	if (err)
	{
		LOG_ERR("Bluetooth init failed (err %d)", err);
		return;
	}

	settings_load();

	err = bt_le_adv_start(BT_LE_ADV_CONN, ad, ARRAY_SIZE(ad), sd, ARRAY_SIZE(sd));
	if (err)
	{
		LOG_ERR("Advertising failed to start (err %d)\n", err);
		return;
	}
	else
	{
		LOG_INF("Advertising successfully started");
	}

	bt_conn_auth_cb_register(&conn_auth_callbacks);
	bt_conn_auth_info_cb_register(&conn_auth_info_callbacks);

	LOG_DBG("Bluetooth init !");
}

static uint8_t m_ble_prev_progress = 0;
static uint8_t m_ble_prev_status = 0;

static void ble_bpt_listener(const struct zbus_channel *chan)
{
	const struct hpi_bpt_t *hpi_bpt = zbus_chan_const_msg(chan);
	if (hpi_bpt->progress == m_ble_prev_progress &&
		hpi_bpt->status == m_ble_prev_status)
	{
		return;
	}
	m_ble_prev_progress = hpi_bpt->progress;
	m_ble_prev_status = hpi_bpt->status;

	ble_bpt_cal_progress_notify(hpi_bpt->status, hpi_bpt->progress);
	LOG_DBG("ZB BPT Status: %d Progress: %d\n", hpi_bpt->status, hpi_bpt->progress);
}
ZBUS_LISTENER_DEFINE(ble_bpt_lis, ble_bpt_listener);

void ble_thread(void)
{
	k_sem_take(&sem_ble_thread_start, K_FOREVER);

	LOG_INF("BLE Thread started");

	for (;;)
	{
		k_sleep(K_MSEC(1000));
	}
}

#define BLE_THREAD_STACKSIZE 1024
#define BLE_THREAD_PRIORITY 7

K_THREAD_DEFINE(ble_thread_id, BLE_THREAD_STACKSIZE, ble_thread, NULL, NULL, NULL, BLE_THREAD_PRIORITY, 0, 1000);
```

## src/ble_module.h
```c
/*
 * HealthyPi Move
 * 
 * SPDX-License-Identifier: MIT
 *
 * Copyright (c) 2025 Protocentral Electronics
 *
 * Author: Ashwin Whitchurch, Protocentral Electronics
 * Contact: ashwin@protocentral.com
 *
 * Permission is hereby granted, free of charge, to any person obtaining a copy
 * of this software and associated documentation files (the "Software"), to deal
 * in the Software without restriction, including without limitation the rights
 * to use, copy, modify, merge, publish, distribute, sublicense, and/or sell
 * copies of the Software, and to permit persons to whom the Software is
 * furnished to do so, subject to the following conditions:
 *
 * The above copyright notice and this permission notice shall be included in all
 * copies or substantial portions of the Software.
 *
 * THE SOFTWARE IS PROVIDED "AS IS", WITHOUT WARRANTY OF ANY KIND, EXPRESS OR
 * IMPLIED, INCLUDING BUT NOT LIMITED TO THE WARRANTIES OF MERCHANTABILITY,
 * FITNESS FOR A PARTICULAR PURPOSE AND NONINFRINGEMENT. IN NO EVENT SHALL THE
 * AUTHORS OR COPYRIGHT HOLDERS BE LIABLE FOR ANY CLAIM, DAMAGES OR OTHER
 * LIABILITY, WHETHER IN AN ACTION OF CONTRACT, TORT OR OTHERWISE, ARISING FROM,
 * OUT OF OR IN CONNECTION WITH THE SOFTWARE OR THE USE OR OTHER DEALINGS IN THE
 * SOFTWARE.
 */


#pragma once
int ble_temp_notify(double temp_c);
void ble_module_init();
void ble_bas_notify(uint8_t batt_level);
void ble_bpt_cal_progress_notify(uint8_t bpt_status, uint8_t bpt_progress);
void hpi_ble_send_data(const uint8_t *data, uint16_t len);

void ble_ppg_notify_wr(uint32_t *ppg_data, uint8_t len);
void ble_ppg_notify_fi(uint32_t *ppg_data, uint8_t len);
void ble_ecg_notify(int32_t *ecg_data, uint8_t len);
void ble_gsr_notify(int32_t *gsr_data, uint8_t len);
```

## src/recording_module.h
```c
/*
 * HealthyPi Move - Recording Module Header
 *
 * SPDX-License-Identifier: MIT
 *
 * Copyright (c) 2025 Protocentral Electronics
 */

#pragma once

#include <zephyr/kernel.h>
#include <stdint.h>
#include <stdbool.h>

/* Signal selection bitmask */
#define REC_SIGNAL_PPG_WRIST    BIT(0)  /* Wrist PPG (IR, Red, Green @ 25 Hz) */
#define REC_SIGNAL_PPG_FINGER   BIT(1)  /* Finger PPG (IR, Red @ 25 Hz) */
#define REC_SIGNAL_IMU_ACCEL    BIT(2)  /* 3-axis accelerometer @ 100 Hz */
#define REC_SIGNAL_IMU_GYRO     BIT(3)  /* 3-axis gyroscope @ 100 Hz */
#define REC_SIGNAL_GSR          BIT(4)  /* Galvanic skin response @ 32 Hz */

#define REC_SIGNAL_ALL          (REC_SIGNAL_PPG_WRIST | REC_SIGNAL_PPG_FINGER | \
                                 REC_SIGNAL_IMU_ACCEL | REC_SIGNAL_IMU_GYRO | \
                                 REC_SIGNAL_GSR)

/* Signal type identifiers for file headers */
enum hpi_rec_signal_type {
    REC_TYPE_PPG_WRIST = 0,
    REC_TYPE_PPG_FINGER = 1,
    REC_TYPE_IMU_ACCEL = 2,
    REC_TYPE_IMU_GYRO = 3,
    REC_TYPE_GSR = 4,
    REC_TYPE_COUNT = 5,
};

/* Recording states */
enum hpi_recording_state {
    REC_STATE_IDLE = 0,
    REC_STATE_ARMED,        /* Configured, waiting for start */
    REC_STATE_RECORDING,    /* Active recording */
    REC_STATE_FINALIZING,   /* Flushing buffers, closing files */
    REC_STATE_ERROR,
};

/* Error codes */
enum hpi_recording_error {
    REC_ERR_NONE = 0,
    REC_ERR_STORAGE_FULL,       /* LittleFS partition full */
    REC_ERR_FILE_CREATE,        /* Failed to create recording file */
    REC_ERR_FILE_WRITE,         /* Failed to write data */
    REC_ERR_INVALID_CONFIG,     /* Invalid configuration parameters */
    REC_ERR_SENSOR_UNAVAILABLE, /* Required sensor not available */
    REC_ERR_BUFFER_OVERFLOW,    /* Data coming faster than write speed */
    REC_ERR_NOT_CONFIGURED,     /* Start called without configure */
    REC_ERR_ALREADY_RECORDING,  /* Start called while already recording */
    REC_ERR_NOT_RECORDING,      /* Stop called while not recording */
};

/* Recording configuration */
struct hpi_recording_config_t {
    uint16_t duration_s;        /* Recording duration in seconds (max 3600 = 1 hour) */
    uint8_t  signal_mask;       /* Bitmask of REC_SIGNAL_* flags */
    uint8_t  sample_decimation; /* Decimation factor (1 = full rate, 2 = half, etc.) */
};

/* Recording session metadata */
struct hpi_recording_session_t {
    int64_t  start_timestamp;   /* Unix timestamp when recording started */
    int64_t  end_timestamp;     /* Unix timestamp when recording ended (0 if active) */
    uint16_t duration_s;        /* Configured duration */
    uint16_t elapsed_s;         /* Current elapsed seconds */
    uint8_t  signal_mask;       /* Active signals */
    uint8_t  state;             /* enum hpi_recording_state */
    uint32_t samples_written;   /* Total samples written across all signals */
    uint8_t  error_code;        /* Error code if state == REC_STATE_ERROR */
};

/* Recording status for ZBus/UI (low-frequency updates) */
struct hpi_recording_status_t {
    uint16_t elapsed_s;         /* Seconds since recording start */
    uint16_t remaining_s;       /* Seconds remaining */
    uint16_t total_s;           /* Total configured duration */
    uint8_t  signal_mask;       /* Active signals being recorded */
    uint8_t  state;             /* Current recording state */
    bool     active;            /* Quick check if recording is active */
};

/* File format header - 32 bytes */
#define REC_FILE_MAGIC      0x48504952  /* "HPIR" - HealthyPi Recording */
#define REC_FILE_VERSION    1

struct hpi_recording_file_header_t {
    uint32_t magic;             /* REC_FILE_MAGIC */
    uint8_t  version;           /* File format version */
    uint8_t  signal_type;       /* Which signal this file contains */
    uint16_t sample_rate_hz;    /* Sample rate for this signal */
    int64_t  start_timestamp;   /* Unix timestamp */
    uint32_t num_samples;       /* Total samples in file (updated at finalize) */
    uint32_t reserved[2];       /* Future use */
} __packed;

#define REC_FILE_HEADER_SIZE 32

/* Session index entry for BLE listing */
struct hpi_recording_index_t {
    int64_t  session_timestamp; /* Session start timestamp */
    uint16_t duration_s;        /* Recording duration */
    uint8_t  signal_mask;       /* Signals recorded */
    uint32_t total_size;        /* Total file size in bytes */
} __packed;

#define REC_INDEX_SIZE 15

/* Sample rate definitions */
#define REC_SAMPLE_RATE_PPG_WRIST   100
#define REC_SAMPLE_RATE_PPG_FINGER  25
#define REC_SAMPLE_RATE_IMU_ACCEL   100
#define REC_SAMPLE_RATE_IMU_GYRO    100
#define REC_SAMPLE_RATE_GSR         32

/* Sample sizes in bytes */
#define REC_SAMPLE_SIZE_PPG_WRIST   12  /* 3 x uint32 (IR, Red, Green) */
#define REC_SAMPLE_SIZE_PPG_FINGER  8   /* 2 x uint32 (IR, Red) */
#define REC_SAMPLE_SIZE_IMU_ACCEL   6   /* 3 x int16 (X, Y, Z) */
#define REC_SAMPLE_SIZE_IMU_GYRO    6   /* 3 x int16 (X, Y, Z) */
#define REC_SAMPLE_SIZE_GSR         4   /* 1 x int32 */

/* Buffer configuration - reduced to save RAM (5 signals x 2 buffers x size) */
#define REC_BUFFER_SIZE  1024  /* 1KB per buffer (10KB total for all signals) */

/* Maximum recording duration in seconds */
#define REC_MAX_DURATION_S  3600  /* 1 hour */

/* Recording directory path */
#define REC_BASE_PATH "/lfs/rec/"

/*
 * Public API
 */

/* Configuration */
int hpi_recording_configure(const struct hpi_recording_config_t *config);
int hpi_recording_get_config(struct hpi_recording_config_t *config);

/* Control */
int hpi_recording_start(void);
int hpi_recording_stop(void);

/* Status */
int hpi_recording_get_status(struct hpi_recording_status_t *status);
bool hpi_recording_is_active(void);

/* Fast inline check for data_thread - no mutex, uses atomic */
static inline bool hpi_recording_is_signal_enabled(uint8_t signal);

/* Buffer API (called from data_module.c) */
void hpi_rec_add_ppg_wrist_samples(const uint32_t *ir, const uint32_t *red,
                                    const uint32_t *green, uint8_t num_samples);
void hpi_rec_add_ppg_finger_samples(const uint32_t *ir, const uint32_t *red,
                                     uint8_t num_samples);
void hpi_rec_add_gsr_samples(const int32_t *samples, uint8_t num_samples);
void hpi_rec_add_imu_accel_samples(const int16_t *x, const int16_t *y,
                                    const int16_t *z, uint8_t num_samples);
void hpi_rec_add_imu_gyro_samples(const int16_t *x, const int16_t *y,
                                   const int16_t *z, uint8_t num_samples);

/* Session management */
int hpi_recording_get_session_count(void);
int hpi_recording_get_session_list(void);  /* Sends via BLE */
int hpi_recording_delete_session(int64_t timestamp);
int hpi_recording_wipe_all(void);

/* Module initialization (called from main) */
int hpi_recording_init(void);

/*
 * External declarations for atomic state flags
 * These are defined in recording_module.c and used for fast path checks
 */
extern atomic_t g_recording_active;
extern atomic_t g_recording_signal_mask;

/* Inline implementation for fast path check */
static inline bool hpi_recording_is_signal_enabled(uint8_t signal)
{
    if (!atomic_get(&g_recording_active)) {
        return false;
    }
    return (atomic_get(&g_recording_signal_mask) & signal) != 0;
}
```
